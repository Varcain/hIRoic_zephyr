## drivers/wm8994/Kconfig
```kconfig
# Copyright (C) 2026 Kamil Lulko <kamil.lulko@gmail.com>
#
# This file is part of hIRoic_zephyr.
#
# hIRoic_zephyr is free software: you can redistribute it and/or modify
# it under the terms of the GNU General Public License as published by
# the Free Software Foundation, either version 3 of the License, or
# (at your option) any later version.
#
# hIRoic_zephyr is distributed in the hope that it will be useful,
# but WITHOUT ANY WARRANTY; without even the implied warranty of
# MERCHANTABILITY or FITNESS FOR A PARTICULAR PURPOSE. See the
# GNU General Public License for more details.
#
# You should have received a copy of the GNU General Public License
# along with hIRoic_zephyr. If not, see <https://www.gnu.org/licenses/>.

config AUDIO_CODEC_WM8994
	bool "Wolfson WM8994 codec support"
	default y
	select I2C
	depends on DT_HAS_WOLFSON_WM8994_ENABLED
	help
	  Enable support for the Wolfson/Cirrus Logic WM8994 audio codec.
```

## drivers/wm8994/dts/bindings/audio/wolfson,wm8994.yaml
```yaml
# Copyright (C) 2026 Kamil Lulko <kamil.lulko@gmail.com>
#
# This file is part of hIRoic_zephyr.
#
# hIRoic_zephyr is free software: you can redistribute it and/or modify
# it under the terms of the GNU General Public License as published by
# the Free Software Foundation, either version 3 of the License, or
# (at your option) any later version.
#
# hIRoic_zephyr is distributed in the hope that it will be useful,
# but WITHOUT ANY WARRANTY; without even the implied warranty of
# MERCHANTABILITY or FITNESS FOR A PARTICULAR PURPOSE. See the
# GNU General Public License for more details.
#
# You should have received a copy of the GNU General Public License
# along with hIRoic_zephyr. If not, see <https://www.gnu.org/licenses/>.

description: Wolfson/Cirrus Logic WM8994 Audio Codec

include: [i2c-device.yaml]

compatible: "wolfson,wm8994"

properties:
  reg:
    required: true
```
